# file: led_button.ioc
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Mcu.Family=STM32F4
RCC.VCOOutputFreq_Value=192000000
RCC.APB2Freq_Value=16000000
RCC.CortexFreq_Value=16000000
Mcu.Name=STM32F407V(E-G)Tx
RCC.SYSCLKFreq_VALUE=16000000
Mcu.Package=LQFP100
ProjectManager.StackSize=0x400
ProjectManager.HeapSize=0x200
ProjectManager.TargetToolchain=STM32CubeIDE
RCC.HSI_VALUE=16000000
NVIC.PriorityGroup=NVIC_PRIORITYGROUP_4
RCC.APB1Freq_Value=16000000
RCC.LSE_VALUE=32768
RCC.AHBFreq_Value=16000000
RCC.HSE_VALUE=25000000
board=custom

// file: Core/Src/main.c
/* USER CODE BEGIN Header */
/**
  ******************************************************************************
  * @file           : main.c
  * @brief          : Main program body
  ******************************************************************************
  * @attention
  *
  * <h2><center>&copy; Copyright (c) 2021 STMicroelectronics.
  * All rights reserved.</center></h2>
  *
  * This software component is licensed by ST under BSD 3-Clause license,
  * the "License"; You may not use this file except in compliance with the
  * License. You may obtain a copy of the License at:
  *                        opensource.org/licenses/BSD-3-Clause
  *
  ******************************************************************************
  */
/* USER CODE END Header */
#include "main.h"

void SystemClock_Config(void);

int main(void)
{

  /* MCU Configuration--------------------------------------------------------*/

  /* Reset of all peripherals, Initializes the Flash interface and the Systick. */
  HAL_Init();

  /* Configure the system clock */
  SystemClock_Config();

  /* Initialize all configured peripherals */
  /* USER CODE BEGIN 2 */
  RCC->AHB1ENR |= (1<<3);     //bit islemleriyle 3.bite 1 verildi.
  RCC->AHB1ENR |= 0x00000001; //0.bite 1 verildi.

  GPIOD->MODER &= ~(1<<27); //13.pin output secildi.
  GPIOD->MODER |= (1<<26);

  GPIOD->MODER &= ~(1<<25); //12.pin output secildi.
  GPIOD->MODER |= (1<<24);

  GPIOD->MODER &= ~(1<<29); //14.pin output secildi.
  GPIOD->MODER |= (1<<28);

  GPIOD->MODER &= ~(1<<31); //15.pin output secildi.
  GPIOD->MODER |= (1<<30);

  GPIOD->OTYPER &= ~(1<<12); //12.pine 0 verildi
  GPIOD->OTYPER &= ~(1<<13); //13.pine 0 verildi
  GPIOD->OTYPER &= ~(1<<14); //14.pine 0 verildi
  GPIOD->OTYPER &= ~(1<<15); //15.pine 0 verildi

  GPIOA->MODER &= ~(1<<1);
  GPIOA->MODER &= ~(0x00000001);

  /* USER CODE END 2 */

  /* Infinite loop */
  /* USER CODE BEGIN WHILE */
  while (1)
  {
	  if(GPIOA->IDR & (0x00000001))
	  	  {
	  		  GPIOD->ODR &= ~(1<<12); // ODR'nin 12. bitine 0 verilir.
	  		  GPIOD->ODR |= (1<<13);  // ODR'nin 13. bitine 1 verilir ve led yanar.
	  		  GPIOD->ODR |= (1<<14);  // ODR'nin 14. bitine 1 verilir ve led yanar.
	  		  GPIOD->ODR &= ~(1<<15); // ODR'nin 15. bitine 0 verilir.
	  		  HAL_Delay(500);         // 500 milisaniye beklenir.
	  		  GPIOD->ODR |= (1<<12);  // ODR'nin 12. bitine 1 verilir ve led yanar.
	  		  GPIOD->ODR &= ~(1<<13); // ODR'nin 13. bitine 0 verilir.
	  		  GPIOD->ODR &= ~(1<<14); // ODR'nin 14. bitine 0 verilir.
	  		  GPIOD->ODR |= (1<<15);  // ODR'nin 15. bitine 1 verilir ve led yanar.
	  		  HAL_Delay(500);
	  	  }

    /* USER CODE END WHILE */

  }
}

void SystemClock_Config(void)
{
  RCC_OscInitTypeDef RCC_OscInitStruct = {0};
  RCC_ClkInitTypeDef RCC_ClkInitStruct = {0};

  /** Configure the main internal regulator output voltage
  */
  __HAL_RCC_PWR_CLK_ENABLE();
  __HAL_PWR_VOLTAGESCALING_CONFIG(PWR_REGULATOR_VOLTAGE_SCALE1);
  /** Initializes the RCC Oscillators according to the specified parameters
  * in the RCC_OscInitTypeDef structure.
  */
  RCC_OscInitStruct.OscillatorType = RCC_OSCILLATORTYPE_HSI;
  RCC_OscInitStruct.HSIState = RCC_HSI_ON;
  RCC_OscInitStruct.HSICalibrationValue = RCC_HSICALIBRATION_DEFAULT;
  RCC_OscInitStruct.PLL.PLLState = RCC_PLL_NONE;
  if (HAL_RCC_OscConfig(&RCC_OscInitStruct) != HAL_OK)
  {
    Error_Handler();
  }
  /** Initializes the CPU, AHB and APB buses clocks
  */
  RCC_ClkInitStruct.ClockType = RCC_CLOCKTYPE_HCLK|RCC_CLOCKTYPE_SYSCLK
                              |RCC_CLOCKTYPE_PCLK1|RCC_CLOCKTYPE_PCLK2;
  RCC_ClkInitStruct.SYSCLKSource = RCC_SYSCLKSOURCE_HSI;
  RCC_ClkInitStruct.AHBCLKDivider = RCC_SYSCLK_DIV1;
  RCC_ClkInitStruct.APB1CLKDivider = RCC_HCLK_DIV1;
  RCC_ClkInitStruct.APB2CLKDivider = RCC_HCLK_DIV1;

  if (HAL_RCC_ClockConfig(&RCC_ClkInitStruct, FLASH_LATENCY_0) != HAL_OK)
  {
    Error_Handler();
  }
}

void Error_Handler(void)
{
  __disable_irq();
  while (1)
  {
  }
}

/************************ (C) COPYRIGHT STMicroelectronics *****END OF FILE****/
